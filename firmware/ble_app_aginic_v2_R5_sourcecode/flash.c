/*===========================================
//
// flash.c
// Written by Alex Gilmour
// Copyright (c) 2024, CarbonCircuits
// All rights reserved.
//
//=========================================*/

#include "flash.h"
#include "system.h"
#include "adc.h"
#include "main.h"
#include "nrf.h"
#include "measure.h"

// The flash is organised into 4096 byte segments. The number of records we can
// store is a function of the record size.

// The flash is organised into 8 segments of 4 pages each.
// Each page is 1kB
// The flash memory may be erased by page (i.e. 1kB chunks)
// The flash memory may be protected by sector (i.e. 4kB chunks)
// The flash module will only write memory that is 0xFFFF, so the chance of overwriting code is low.
// Memory protection may be implemented in the future, but for now it impacts the ability to re-write the code on the device.
#define FLASH_PAGE_SIZE		(0x1000)

#define FLASH_NUM_PAGES		(10)

#define FLASH_STORAGE_SIZE		(FLASH_NUM_PAGES * FLASH_PAGE_SIZE)
#define FLASH_PAGE_RECORDS		(FLASH_PAGE_SIZE / sizeof(reid_ble_summary_packet_t))

#define BLANK_PAGE \
{\
0xFFFF, 0xFFFF, 0xFFFF, 0xFFFF, 0xFFFF, 0xFFFF, 0xFFFF, 0xFFFF, 0xFFFF, 0xFFFF, 0xFFFF, 0xFFFF, 0xFFFF, 0xFFFF, 0xFFFF, 0xFFFF, 0xFFFF, 0xFFFF, 0xFFFF, 0xFFFF, 0xFFFF, 0xFFFF, 0xFFFF, 0xFFFF, 0xFFFF, 0xFFFF, 0xFFFF, 0xFFFF, 0xFFFF, 0xFFFF, 0xFFFF, 0xFFFF, \
0xFFFF, 0xFFFF, 0xFFFF, 0xFFFF, 0xFFFF, 0xFFFF, 0xFFFF, 0xFFFF, 0xFFFF, 0xFFFF, 0xFFFF, 0xFFFF, 0xFFFF, 0xFFFF, 0xFFFF, 0xFFFF, 0xFFFF, 0xFFFF, 0xFFFF, 0xFFFF, 0xFFFF, 0xFFFF, 0xFFFF, 0xFFFF, 0xFFFF, 0xFFFF, 0xFFFF, 0xFFFF, 0xFFFF, 0xFFFF, 0xFFFF, 0xFFFF, \
0xFFFF, 0xFFFF, 0xFFFF, 0xFFFF, 0xFFFF, 0xFFFF, 0xFFFF, 0xFFFF, 0xFFFF, 0xFFFF, 0xFFFF, 0xFFFF, 0xFFFF, 0xFFFF, 0xFFFF, 0xFFFF, 0xFFFF, 0xFFFF, 0xFFFF, 0xFFFF, 0xFFFF, 0xFFFF, 0xFFFF, 0xFFFF, 0xFFFF, 0xFFFF, 0xFFFF, 0xFFFF, 0xFFFF, 0xFFFF, 0xFFFF, 0xFFFF, \
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0xFFFF, 0xFFFF, 0xFFFF, 0xFFFF, 0xFFFF, 0xFFFF, 0xFFFF, 0xFFFF, 0xFFFF, 0xFFFF, 0xFFFF, 0xFFFF, 0xFFFF, 0xFFFF, 0xFFFF, 0xFFFF, 0xFFFF, 0xFFFF, 0xFFFF, 0xFFFF, 0xFFFF, 0xFFFF, 0xFFFF, 0xFFFF, 0xFFFF, 0xFFFF, 0xFFFF, 0xFFFF, 0xFFFF, 0xFFFF, 0xFFFF, 0xFFFF  \
}

volatile flash_sysdata_t flash_sysdata __attribute__((used)) = 
{
	.device_uid				= 0xFFFFFFFF,
	.device_version			= DEVICE_FW_VERSION
};

typedef union flash_records_page_t
{
	uint16_t		data[FLASH_PAGE_SIZE/2];
	reid_ble_summary_packet_t	records[FLASH_PAGE_RECORDS];
} flash_records_page_t;

const __attribute__((used)) uint8_t copyright_message[] /*__attribute__((used))*/ = "   Written by Alex Gilmour. Copyright (c) 2022 Reid Technologies. All rights reserved.   ";

const volatile __attribute__((aligned(FLASH_PAGE_SIZE),used)) flash_records_page_t flash_measurements[FLASH_NUM_PAGES] = \
{BLANK_PAGE,BLANK_PAGE,BLANK_PAGE,BLANK_PAGE,BLANK_PAGE,\
BLANK_PAGE,BLANK_PAGE,BLANK_PAGE,BLANK_PAGE,BLANK_PAGE};

static volatile uint32_t flash_high_index;

static void flash_erase_generic(uint16_t* flash);	// erases a single segment of flash
static void flash_write_generic(uint16_t* flash, const uint16_t* data, uint16_t length_bytes);
static void flash_write_16bit(uint32_t flash, uint16_t data);

static inline void wait_for_flash_ready(void)
{
    while (NRF_NVMC->READY == NVMC_READY_READY_Busy) {;}
}

void flash_init(void)
{
	flash_sysdata.device_uid = NRF_FICR->DEVICEADDR[0];
	flash_sysdata.device_version = DEVICE_FW_VERSION;
	
	uint32_t max_time_s = 0;
	max_time_s = (*((volatile uint8_t*)copyright_message))-0x20;
	
    flash_high_index = 0;
	// initialise the counters
	for (uint32_t i=0; i<FLASH_NUM_PAGES; ++i) {
		for (uint32_t j=0; j<FLASH_PAGE_RECORDS; ++j) {
			if   (((*((volatile uint32_t*)&flash_measurements[i].records[j].time_s_start)) != 0xFFFFFFFF)
				&&((*((volatile uint32_t*)&flash_measurements[i].records[j].time_s_end)) != 0xFFFFFFFF)
				&&((*((volatile uint32_t*)&flash_measurements[i].records[j].index)) != 0xFFFFFFFF)
				&&((*((volatile uint32_t*)&flash_measurements[i].records[j].index)) >= flash_high_index))
			{
				flash_high_index = (*((volatile uint32_t*)&flash_measurements[i].records[j].index))+1;
				max_time_s = (*((volatile uint32_t*)&flash_measurements[i].records[j].time_s_end));
			}
		}
	}
	//write_index %= (FLASH_PAGE_RECORDS * FLASH_NUM_PAGES);
	system_set_time(max_time_s+5);
	// check for empty spot; if it's not empty and we're on the edge of a page, advance to the next page
    reid_ble_summary_packet_t* next_write = (reid_ble_summary_packet_t*) &flash_measurements[(flash_high_index/FLASH_PAGE_RECORDS)%FLASH_NUM_PAGES].records[flash_high_index%FLASH_PAGE_RECORDS];
	if (((next_write->time_s_start) != 0xFFFFFFFF)||((next_write->time_s_end) != 0xFFFFFFFF)||((next_write->index) != 0xFFFFFFFF)) {
		flash_high_index = (((flash_high_index-1)/FLASH_PAGE_RECORDS)+1)*FLASH_PAGE_RECORDS;
	}
	// the write procedure will automatically erase on a new page anyway
	return;
}

void flash_deinit(void)
{
	return;
}

void flash_reset_all(void)
{
	ble_reid_force_disconnect();

	for (uint32_t i=0; i < FLASH_NUM_PAGES; ++i)
	{
		flash_erase_generic((uint16_t*) &(flash_measurements[i].records[0]));
	}
	flash_high_index = (((flash_high_index-1)/FLASH_PAGE_RECORDS)+1)*FLASH_PAGE_RECORDS;
	
    ble_advertise_again();
}

void flash_write_record(reid_ble_summary_packet_t* record)
{
	ble_reid_force_disconnect();

	static volatile reid_ble_summary_packet_t data_to_copy;
	memcpy((reid_ble_summary_packet_t*)&data_to_copy, record, sizeof(reid_ble_summary_packet_t));
    data_to_copy.index = flash_high_index;

	uint16_t* write_to = (uint16_t*) &(flash_measurements[(flash_high_index/FLASH_PAGE_RECORDS)%FLASH_NUM_PAGES].records[(flash_high_index%FLASH_PAGE_RECORDS)]);
	
	if ((flash_high_index % FLASH_PAGE_RECORDS) == 0) flash_erase_generic((uint16_t*) &(flash_measurements[(flash_high_index/FLASH_PAGE_RECORDS)% FLASH_NUM_PAGES].records[0]));

	flash_write_generic(write_to, (uint16_t*) &data_to_copy, sizeof(reid_ble_summary_packet_t));
	++flash_high_index;
	
    ble_advertise_again();
}

reid_ble_summary_packet_t* flash_get_record(uint32_t req_index)
{
	reid_ble_summary_packet_t* ret_val = (reid_ble_summary_packet_t*) &flash_measurements[(req_index/FLASH_PAGE_RECORDS)%FLASH_NUM_PAGES].records[req_index%FLASH_PAGE_RECORDS];
	if (((ret_val->time_s_start) != 0xFFFFFFFF)&&((ret_val->time_s_end) != 0xFFFFFFFF)&&(ret_val->index == req_index)) {
		return ret_val;
	} else {
		return NULL;
	}
}

void flash_get_all_indices(uint32_t* low_index, uint32_t* high_index)
{
	uint32_t ret_high = 0;
	uint32_t ret_low = 0xFFFFFFFFul;

	for (uint32_t i=0; i<FLASH_NUM_PAGES; ++i)
	{
		for (uint32_t j=0; j<FLASH_PAGE_RECORDS; ++j)
		{
			if (((*((volatile uint32_t*)&flash_measurements[i].records[j].time_s_start)) != 0xFFFFFFFF)
			 && ((*((volatile uint32_t*)&flash_measurements[i].records[j].time_s_end)) != 0xFFFFFFFF))
			{
				if ((*((volatile uint32_t*)&flash_measurements[i].records[j].index)) > ret_high) ret_high = (*((volatile uint32_t*)&flash_measurements[i].records[j].index));
				if ((*((volatile uint32_t*)&flash_measurements[i].records[j].index)) < ret_low) ret_low = (*((volatile uint32_t*)&flash_measurements[i].records[j].index));
			}
		}
	}

	if (low_index != NULL) *low_index = ret_low;
	if (high_index != NULL) *high_index = ret_high;
}

void flash_get_pending_indices(uint32_t* low_index, uint32_t* high_index)
{
	uint32_t ret_high = 0;
	uint32_t ret_low = 0xFFFFFFFFul;

	for (uint32_t i=0; i<FLASH_NUM_PAGES; ++i)
	{
		for (uint32_t j=0; j<FLASH_PAGE_RECORDS; ++j)
		{
			if (((*((volatile uint32_t*)&flash_measurements[i].records[j].time_s_start)) != 0xFFFFFFFF)
			 && ((*((volatile uint32_t*)&flash_measurements[i].records[j].time_s_end)) != 0xFFFFFFFF)
			 && ((*((volatile uint16_t*)&flash_measurements[i].records[j].is_synced)) != FLASH_DATA_SYNCED_MARKER))
			{
				if ((*((volatile uint32_t*)&flash_measurements[i].records[j].index)) > ret_high) ret_high = (*((volatile uint32_t*)&flash_measurements[i].records[j].index));
				if ((*((volatile uint32_t*)&flash_measurements[i].records[j].index)) < ret_low) ret_low = (*((volatile uint32_t*)&flash_measurements[i].records[j].index));
			}
		}
	}

	if (low_index != NULL) *low_index = ret_low;
	if (high_index != NULL) *high_index = ret_high;
}

uint32_t flash_next_high_index(void)
{
	return flash_high_index;
}

void flash_mark_record_synced(uint32_t req_index)
{
	__attribute__((aligned(4))) uint16_t mark_synced = FLASH_DATA_SYNCED_MARKER;

	reid_ble_summary_packet_t* to_mark = (reid_ble_summary_packet_t*) &flash_measurements[(req_index/FLASH_PAGE_RECORDS)%FLASH_NUM_PAGES].records[req_index%FLASH_PAGE_RECORDS];
	
	if ((to_mark->time_s_start != 0xFFFFFFFF)
	 && (to_mark->time_s_end != 0xFFFFFFFF)
	 && (to_mark->is_synced != FLASH_DATA_SYNCED_MARKER)
	 && (to_mark->index == req_index))
	{
		flash_write_generic((uint16_t*) &(to_mark->is_synced), (uint16_t*) &mark_synced, 2);
	}
}

void flash_mark_records_synced(uint32_t low_index, uint32_t high_index)
{
	__attribute__((aligned(4))) uint16_t mark_synced = FLASH_DATA_SYNCED_MARKER;

	for (uint32_t i=0; i<FLASH_NUM_PAGES; ++i)
	{
		for (uint32_t j=0; j<FLASH_PAGE_RECORDS; ++j)
		{
			if (((*((volatile uint32_t*)&flash_measurements[i].records[j].time_s_start)) != 0xFFFFFFFF)
			 && ((*((volatile uint32_t*)&flash_measurements[i].records[j].time_s_end)) != 0xFFFFFFFF)
			 && ((*((volatile uint16_t*)&flash_measurements[i].records[j].is_synced)) != FLASH_DATA_SYNCED_MARKER)
			 && ((*((volatile uint32_t*)&flash_measurements[i].records[j].index)) <= high_index)
			 && ((*((volatile uint32_t*)&flash_measurements[i].records[j].index)) >= low_index))
			{
				flash_write_generic((uint16_t*) &flash_measurements[i].records[j].is_synced, (uint16_t*) &mark_synced, 2);
			}
		}
	}
}

static void flash_erase_generic(uint16_t* flash)
{
	safe_disable_interrupt();
    // Enable erase.
    NRF_NVMC->CONFIG = NVMC_CONFIG_WEN_Een;
    __ISB();
    __DSB();

    // Erase the page
    NRF_NVMC->ERASEPAGE = (uint32_t) flash;
    wait_for_flash_ready();

    NRF_NVMC->CONFIG = NVMC_CONFIG_WEN_Ren;
    __ISB();
    __DSB();

    safe_enable_interrupt();
}

static void flash_write_generic(uint16_t* flash, const uint16_t* data, uint16_t length_bytes)
{
	for (uint16_t i = 0; i<(length_bytes>>1); ++i)
	{
		flash_write_16bit(((uint32_t) flash) + (i*2), *(data+i));
	}
}

static void flash_write_16bit(uint32_t flash, uint16_t data)
{
	// Load the 4-byte aligned memory address, and the existing data at that location
	__attribute__((aligned(4))) uint32_t address = (flash >> 2)<<2;
	__attribute__((aligned(4))) uint32_t data_to_write = *((uint32_t*)address);
	
	// Mask existing data, and add the data to be written into it
	if (address == flash) data_to_write = (data_to_write & 0xFFFF0000) | ((uint32_t)data);
	else data_to_write = (data_to_write & 0x0000FFFF) | (((uint32_t)data) << 16);
	
    safe_disable_interrupt();
    // Enable write.
	NRF_NVMC->CONFIG = NVMC_CONFIG_WEN_Wen;
	__ISB();
	__DSB();

	*((uint32_t*)address) = data_to_write;
	wait_for_flash_ready();

	NRF_NVMC->CONFIG = NVMC_CONFIG_WEN_Ren;
	__ISB();
	__DSB();
    
    safe_enable_interrupt();
}

